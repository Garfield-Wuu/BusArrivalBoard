## firmware/main/Kconfig.projbuild
```kconfig
menu "BusArrivalBoard Configuration"

    menu "WiFi"

        config BUS_WIFI_SSID
            string "WiFi SSID"
            default ""
            help
                留空则跳过直连、直接进 SmartConfig 配网。
                首次刷机建议留空，用微信扫码配网，凭据会存入 NVS。

        config BUS_WIFI_PASSWORD
            string "WiFi 密码"
            default ""
            help
                注意：填了密码后 sdkconfig 就含明文凭据，该文件已在
                .gitignore 中，不要手动提交。

        config BUS_WIFI_CONNECT_TIMEOUT_MS
            int "WiFi 连接超时（毫秒）"
            default 15000
            range 5000 60000
            help
                超时后若启用 SmartConfig 会转入配网模式。

        config BUS_WIFI_ENABLE_SMARTCONFIG
            bool "启用 SmartConfig 配网"
            default y
            help
                连接失败时进入 SmartConfig（ESP-Touch v2），
                用微信小程序或 EspTouch App 扫码下发凭据。

        config BUS_WIFI_SMARTCONFIG_TIMEOUT_MS
            int "SmartConfig 超时（毫秒）"
            depends on BUS_WIFI_ENABLE_SMARTCONFIG
            default 120000
            range 30000 600000
            help
                配网等待时长，超时后进深度睡眠重试，避免空耗电量。

    endmenu

    menu "服务端"

        config BUS_SERVER_URL
            string "帧接口 URL"
            default "http://192.168.1.100:8000/api/epd/frame.bin"
            help
                BusArrivalBoard 服务端的帧下载地址。
                注意 ESP32 不能连仅 5GHz 的网络，服务端需在同一 2.4G 局域网。

        config BUS_SERVER_TOKEN
            string "设备认证 Token"
            default ""
            help
                可选。服务端设了 BUS_API_TOKEN 时必须填写一致的值，
                会通过 X-Device-Token 头发送。

        config BUS_HTTP_TIMEOUT_MS
            int "HTTP 超时（毫秒）"
            default 15000
            range 3000 60000

    endmenu

    menu "墨水屏"

        choice BUS_EPD_MODEL
            prompt "屏幕型号"
            default BUS_EPD_MODEL_UC8176_BW
            help
                当前仅完整实现 UC8176 黑白。

            config BUS_EPD_MODEL_UC8176_BW
                bool "4.2寸 黑白 UC8176 (400x300)"

        endchoice

        config BUS_EPD_WIDTH
            int "屏幕宽度（像素）"
            default 400

        config BUS_EPD_HEIGHT
            int "屏幕高度（像素）"
            default 300

        menu "引脚定义"

            config BUS_EPD_PIN_SCK
                int "SPI SCK"
                default 12

            config BUS_EPD_PIN_MOSI
                int "SPI MOSI"
                default 11

            config BUS_EPD_PIN_CS
                int "CS 片选"
                default 10

            config BUS_EPD_PIN_DC
                int "DC 数据/命令"
                default 8

            config BUS_EPD_PIN_RST
                int "RST 复位"
                default 7

            config BUS_EPD_PIN_BUSY
                int "BUSY 忙碌"
                default 9

        endmenu

    endmenu

    menu "电源管理"

        config BUS_SLEEP_INTERVAL_SEC
            int "深度睡眠间隔（秒）"
            default 300
            range 60 3600
            help
                两次刷新之间的休眠时长。墨水屏建议不低于 300 秒，
                过于频繁的全屏刷新会加剧残影并缩短屏幕寿命。

        config BUS_BATTERY_MONITOR_ENABLE
            bool "启用电池电压监测"
            default y
            help
                通过 ADC 读取电池电压，判断低电量并上报给服务端。
                需要外部分压电阻网络（100kΩ+100kΩ，1:1 分压）。

        config BUS_BATTERY_ADC_CHANNEL
            int "电池监测 ADC 通道"
            depends on BUS_BATTERY_MONITOR_ENABLE
            default 0
            range 0 9
            help
                ADC1 通道号（0-9）。ESP32-S3 上，ADC1_CH0 = GPIO1。
                具体映射参考数据手册。

        config BUS_BATTERY_DIVIDER_RATIO
            int "分压比（放大 100 倍）"
            depends on BUS_BATTERY_MONITOR_ENABLE
            default 200
            range 100 1000
            help
                电池电压 = ADC 读数 × (此值 / 100)。
                1:1 分压（100kΩ+100kΩ）配 200；1:2 分压配 300。

        config BUS_BATTERY_LOW_MV
            int "低电量阈值（毫伏）"
            depends on BUS_BATTERY_MONITOR_ENABLE
            default 3400
            range 3000 3700
            help
                低于此电压时上报低电量警告。单节锂电 3.3V 以下会加速老化，
                3.4V 是留出余量的告警点。

        config BUS_NIGHT_MODE_ENABLE
            bool "夜间省电模式"
            default y
            help
                夜间公交停运，跳过刷新可显著延长电池续航。

        config BUS_NIGHT_START_HOUR
            int "夜间开始小时 (0-23)"
            depends on BUS_NIGHT_MODE_ENABLE
            default 23
            range 0 23

        config BUS_NIGHT_END_HOUR
            int "夜间结束小时 (0-23)"
            depends on BUS_NIGHT_MODE_ENABLE
            default 6
            range 0 23

    endmenu

endmenu
```

## firmware/sdkconfig.defaults
```kconfig
# ESP-IDF SDK 配置默认值
#
# 用于固定构建行为，确保在不同机器上编译结果一致。
# 用户可以用 idf.py menuconfig 覆盖这些默认值。

# 目标芯片：ESP32-S3（优先推荐，向下兼容 ESP32/ESP32-C3）
CONFIG_IDF_TARGET="esp32s3"

# 分区表：支持 OTA 固件升级（factory + 2 个 OTA 分区）
CONFIG_PARTITION_TABLE_CUSTOM=y
CONFIG_PARTITION_TABLE_CUSTOM_FILENAME="partitions.csv"
CONFIG_PARTITION_TABLE_FILENAME="partitions.csv"

# WiFi 性能优化
CONFIG_ESP_WIFI_STATIC_RX_BUFFER_NUM=10
CONFIG_ESP_WIFI_DYNAMIC_RX_BUFFER_NUM=32
CONFIG_ESP_WIFI_DYNAMIC_TX_BUFFER_NUM=32

# 深度睡眠唤醒源
CONFIG_ESP_SLEEP_RTC_TIMER_WAKEUP=y

# 日志等级：默认 INFO，生产环境可改 WARN
CONFIG_LOG_DEFAULT_LEVEL_INFO=y

# 编译优化：优化体积（-Os），Flash 有限时重要
CONFIG_COMPILER_OPTIMIZATION_SIZE=y

# 禁用不需要的组件以节省 Flash
CONFIG_BT_ENABLED=n

# 栈大小：主任务需要足够空间（渲染用）
CONFIG_ESP_MAIN_TASK_STACK_SIZE=8192

# watchdog 超时：网络下载可能较慢，放宽超时
CONFIG_ESP_TASK_WDT_TIMEOUT_S=10
```
